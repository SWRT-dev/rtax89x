## release/src-qca-ipq806x/linux/linux-4.4.x.spf8/arch/arm/mach-qcom/Kconfig
```kconfig
menuconfig ARCH_QCOM
	bool "Qualcomm Support" if ARCH_MULTI_V7
	select ARCH_SUPPORTS_BIG_ENDIAN
	select ARM_GIC
	select ARM_AMBA
	select PINCTRL
	select QCOM_SCM if SMP
	select PCI_DOMAINS if PCI
	help
	  Support for Qualcomm's devicetree based systems.

if ARCH_QCOM

config ARCH_MSM8X60
	bool "Enable support for MSM8X60"
	select CLKSRC_QCOM

config ARCH_MSM8960
	bool "Enable support for MSM8960"
	select CLKSRC_QCOM

config ARCH_MSM8974
	bool "Enable support for MSM8974"
	select HAVE_ARM_ARCH_TIMER

config ARCH_IPQ807x
	bool "Enable Support for IPQ807x"
	select PINCTRL_IPQ807x
	select COMMON_CLK_QCOM
	select IPQ_APSS_807x
	select IPQ_GCC_807x
	help
	  This enables support for the IPQ807x chipset. If you dont
	  know what do here, say N

choice
	prompt "IPQ806X/IPQ807X models"
config QCA_AP148
	depends on ARCH_IPQ807x
	bool "QCA AP148-XXX"

config ASUS_BRTAC828
	depends on ARCH_IPQ807x
	bool "ASUS BRT-AC828"

config ASUS_RTAD7200
	depends on ARCH_IPQ807x
	bool "ASUS RT-AD7200"

config QCA_APHK01
	depends on ARCH_IPQ807x
	bool "QCA AP.HK01"

config ASUS_GTAXY16000
	depends on ARCH_IPQ807x
	bool "ASUS GT-AXY16000, RT-AX89U"

endchoice

choice
	prompt "Switch chip"

config SWITCH_QCA8337N
	depends on ARCH_IPQ807x
	bool "QCA8337N"

config SWITCH_RTL8370M_PHY_QCA8033_X2
	depends on ARCH_IPQ807x
	bool "Realtek RTL8370M-GR switch and QCA8033 PHY x 2"
	select RTL8370_SDK

config SWITCH_RTL8370MB_PHY_QCA8033_X2
	depends on ARCH_IPQ807x
	bool "Realtek RTL8370MB switch and QCA8033 PHY x 2"
	select RTL8370MB_SDK

endchoice

endif
```
