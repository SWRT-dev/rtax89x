/*
 * Copyright (c) 2016, The Linux Foundation. All rights reserved.
 *
 * This program is free software; you can redistribute it and/or modify
 * it under the terms of the GNU General Public License version 2 and
 * only version 2 as published by the Free Software Foundation.
 *
 * This program is distributed in the hope that it will be useful,
 * but WITHOUT ANY WARRANTY; without even the implied warranty of
 * MERCHANTABILITY or FITNESS FOR A PARTICULAR PURPOSE.  See the
 * GNU General Public License for more details.
 */

/dts-v1/;
#include "ipq807x-soc.dtsi"
#include <dt-bindings/qcom/gpio-ipq807x.h>
/ {
	model ="QCA, IPQ807x-HK01";
	compatible = "qca,ipq807x", "qca,ipq807x-hk01";
	machid = <0x08010000>;
	config_name = "config@hk01";

	aliases {
		console = "/serial@78B3000";
		uart2 = "/serial@78B0000";
		i2c0 = "/i2c@78b6000";
		pci0 = "/pci@20000000";
		pci1 = "/pci@10000000";
	};
	ess-switch {
		switch_mac_mode = <0x5>;	/* enum port_wrapper_cfg */
		switch_mac_mode1 = <0xFF>;
		switch_mac_mode2 = <0x2>;
		sfp_port = <4>;
		sfp_gpio = <59>;		/* PCB R1.00 ~ R3.50 */
		aquantia_port = <5>;
		aquantia_gpio = <63>;
	};

};

